## base_external/Config.in
```kconfig
menu "SEMS external options"
    source "$BR2_EXTERNAL_BASE_EXTERNAL_PATH/package/sems-dashboard/Config.in"
endmenu
```

## base_external/configs/sems_rpi4_defconfig
```kconfig
BR2_aarch64=y
BR2_TOOLCHAIN_BUILDROOT_UCLIBC=y
BR2_PACKAGE_HOST_LINUX_HEADERS_CUSTOM_6_6=y
BR2_TARGET_GENERIC_GETTY_PORT="ttyAMA0"
BR2_ROOTFS_OVERLAY="$(BR2_EXTERNAL_BASE_EXTERNAL_PATH)/board/sems/overlays"
BR2_ROOTFS_POST_BUILD_SCRIPT="$(BR2_EXTERNAL_BASE_EXTERNAL_PATH)/board/sems/post-build.sh"
BR2_ROOTFS_POST_IMAGE_SCRIPT="$(BR2_EXTERNAL_BASE_EXTERNAL_PATH)/board/sems/post-image.sh"
BR2_LINUX_KERNEL=y
BR2_LINUX_KERNEL_CUSTOM_GIT=y
BR2_LINUX_KERNEL_CUSTOM_REPO_URL="https://github.com/raspberrypi/linux.git"
BR2_LINUX_KERNEL_CUSTOM_REPO_VERSION="rpi-6.6.y"
BR2_LINUX_KERNEL_DEFCONFIG="bcm2711"
BR2_LINUX_KERNEL_DTS_SUPPORT=y
BR2_LINUX_KERNEL_INTREE_DTS_NAME="broadcom/bcm2711-rpi-4-b"
BR2_PACKAGE_BUSYBOX_SHOW_OTHERS=y
BR2_PACKAGE_RPI_FIRMWARE=y
BR2_PACKAGE_I2C_TOOLS=y
BR2_PACKAGE_SQLITE=y
BR2_PACKAGE_MOSQUITTO=y
BR2_PACKAGE_NTP=y
```

## base_external/package/sems-dashboard/Config.in
```kconfig
config BR2_PACKAGE_SEMS_DASHBOARD
    bool "SEMS Web Dashboard (Node + React)"
    select BR2_PACKAGE_NODEJS
    help
      Instala el dashboard de SEMS.
      Requiere que el repo tenga:
        - frontend/dist
        - backend/node_modules (solo runtime)
```

## br2-external/Config.in
```kconfig
menu "SEMS external options"
    source "$BR2_EXTERNAL_SEMS_PATH/package/sems-sensor-daemon/Config.in"
endmenu
```

## br2-external/configs/sems_rpi4_defconfig
```kconfig
BR2_aarch64=y
BR2_TOOLCHAIN_BUILDROOT_GLIBC=y

# Board
BR2_PACKAGE_RPI_FIRMWARE=y
BR2_LINUX_KERNEL=y
BR2_LINUX_KERNEL_CUSTOM_TARBALL=y
BR2_LINUX_KERNEL_CUSTOM_TARBALL_LOCATION="https://cdn.kernel.org/pub/linux/kernel/v6.x/linux-6.6.55.tar.xz"
BR2_LINUX_KERNEL_DEFCONFIG="bcm2711"
BR2_LINUX_KERNEL_DTS_SUPPORT=y
BR2_LINUX_KERNEL_INTREE_DTS_NAME="broadcom/bcm2711-rpi-4-b"

# Filesystem e imagen
BR2_ROOTFS_OVERLAY="$(BR2_EXTERNAL_SEMS_PATH)/board/sems/overlays"
BR2_ROOTFS_POST_BUILD_SCRIPT="$(BR2_EXTERNAL_SEMS_PATH)/board/sems/post-build.sh"
BR2_ROOTFS_POST_IMAGE_SCRIPT="$(BR2_EXTERNAL_SEMS_PATH)/board/sems/post-image.sh"
BR2_TARGET_GENERIC_GETTY_PORT="ttyAMA0"
BR2_PACKAGE_BUSYBOX_SHOW_OTHERS=y

# Paquetes necesarios
BR2_PACKAGE_PYTHON3=y
BR2_PACKAGE_PYTHON3_PIP=y
BR2_PACKAGE_PYTHON_PIP=y
BR2_PACKAGE_SQLITE=y
BR2_PACKAGE_MOSQUITTO=y
BR2_PACKAGE_MOSQUITTO_CLIENT=y
BR2_PACKAGE_NTP=y
BR2_PACKAGE_I2C_TOOLS=y

# Nuestro paquete
BR2_PACKAGE_SEMS_SENSOR_DAEMON=y
```

## br2-external/package/sems-sensor-daemon/Config.in
```kconfig
config BR2_PACKAGE_SEMS_SENSOR_DAEMON
    bool "sems-sensor-daemon"
    help
      Daemon de sensores para SEMS (lectura I2C y logging).
```
